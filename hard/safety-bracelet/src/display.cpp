#include "display.h"
#include "utils.h"
#include "ble_manager.h"
#include "wifi_manager.h"
#include "sensors.h"

// Display instance
static Adafruit_SSD1306 display(SCREEN_WIDTH, SCREEN_HEIGHT, &Wire, OLED_RESET);

// Display state variables
static DisplayPage currentPage = STATUS_PAGE;
static DisplayPage previousPage = STATUS_PAGE;
static unsigned long lastPageRotationTime = 0;
static unsigned long lastPageRefreshTime = 0;
static const unsigned long pageRefreshInterval = 5000;
static const unsigned long touchRefreshInterval = 250;
static bool autoRotatePages = true;
static bool forceDisplayRefresh = false;

// QR code data
static String qrCodeUrl = "";
static String childData = "";

// Initialize the display
void displayInit() {
  logInfo("DISPLAY", "Initializing display");
  
  // Initialize with the I2C address
  if(!display.begin(SSD1306_SWITCHCAPVCC, SCREEN_ADDRESS)) {
    logError("DISPLAY", "SSD1306 allocation failed");
    return;
  }
  
  // Clear the buffer
  display.clearDisplay();
  display.setTextSize(1);
  display.setTextColor(SSD1306_WHITE);
  display.setCursor(0, 0);
  display.println("Display initialized");
  display.display();
  
  logInfo("DISPLAY", "Display initialized successfully");
}

// Logo bitmap - 128x64 pixels
const unsigned char logo [] PROGMEM = {
  0x00, 0x00, 0x00, 0x00, 0x00, 0x00, 0x00, 0x00, 0x00, 0x00, 0x00, 0x00, 0x00, 0x00, 0x00, 0x00, 
	0x00, 0x00, 0x00, 0x00, 0x00, 0x00, 0x00, 0x00, 0x00, 0x00, 0x00, 0x00, 0x00, 0x00, 0x00, 0x00, 
	0x00, 0x00, 0x00, 0x00, 0x00, 0x00, 0x00, 0x00, 0x00, 0x00, 0x00, 0x00, 0x00, 0x00, 0x00, 0x00, 
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	0x00, 0x00, 0x00, 0x00, 0x00, 0x00, 0x00, 0x00, 0x00, 0x00, 0x00, 0x00, 0x00, 0x00, 0x00, 0x00
};

// Display the company/safety logo
void displayLogo() {
  display.clearDisplay();
  
  // Draw the bitmap logo
  display.drawBitmap(0, 0, logo, SCREEN_WIDTH, SCREEN_HEIGHT, SSD1306_WHITE);
  
  // Update display with bitmap data
  display.display();
  
  // Show the logo for 3 seconds
  delay(3000);
  
  logInfo("DISPLAY", "Logo displayed");
}

// Set the current display page
void setDisplayPage(DisplayPage page) {
  if (page < NUM_PAGES) {
    currentPage = page;
    forceDisplayRefresh = true;
  }
}

// Update the display (should be called regularly from main loop)
void updateDisplay() {
  // Only update the display if needed (when page changes or forced refresh)
  if (currentPage != previousPage || forceDisplayRefresh || 
      (millis() - lastPageRefreshTime > touchRefreshInterval)) {
    
    switch (currentPage) {
      case STATUS_PAGE:
        displayStatusPage();
        break;
      case SENSOR_PAGE:
        displaySensorPage();
        break;
      case QR_CODE_PAGE:
        displayQrCodePage();
        break;
      case INSTRUCTIONS_PAGE:
        displayInstructionsPage();
        break;
      default:
        displayStatusPage();
        break;
    }
    
    previousPage = currentPage;
    forceDisplayRefresh = false;
    lastPageRefreshTime = millis();
  }
}

// Handle automatic page rotation
void rotateDisplayPage() {
  // Auto rotate pages if enabled and time interval has passed
  if (autoRotatePages && (millis() - lastPageRotationTime > pageRefreshInterval)) {
    currentPage = static_cast<DisplayPage>((currentPage + 1) % NUM_PAGES);
    lastPageRotationTime = millis();
    forceDisplayRefresh = true;
  }
}

// Display the bracelet status page (Internet, BLE, Battery)
void displayStatusPage() {
  display.clearDisplay();
  display.setTextSize(1);
  display.setTextColor(SSD1306_WHITE);
  
  // Page title
  display.setCursor(5, 0);
  display.println("-- BRACELET STATUS --");
  
  // Internet Connection Status
  display.setCursor(0, 16);
  display.print("Internet: ");
  if (isNetworkConnected()) {
    if (getCurrentConnectionMode() == WIFI_MODE) {
      display.println("WiFi OK");
    } else if (getCurrentConnectionMode() == GPRS_MODE) {
      display.println("GPRS OK");
    }
  } else {
    display.println("DISCONNECTED");
  }
  
  // BLE Connection Status
  display.setCursor(0, 28);
  display.print("BLE: ");
  if (isBLEConnected()) {
    display.println("Connected");
  } else {
    if (isBLEEnabled()) {
      display.println("Waiting");
    } else {
      display.println("Disabled");
    }
  }
  
  // Battery Status
  display.setCursor(0, 40);
  display.print("Battery: ");
  display.print(getBatteryPercentage());
  display.println("%");
  
  // Draw battery icon
  int batteryWidth = 30;
  int batteryHeight = 10;
  int filledWidth = (getBatteryPercentage() * batteryWidth) / 100;
  
  display.drawRect(80, 40, batteryWidth, batteryHeight, SSD1306_WHITE);
  display.drawRect(80 + batteryWidth, 42, 3, 6, SSD1306_WHITE); // Battery tip
  display.fillRect(80, 40, filledWidth, batteryHeight, SSD1306_WHITE); // Fill based on percentage
  
  // Page number
  display.setCursor(0, 56);
  display.print("Page 1/4");
  
  display.display();
}

// Display the sensor status page showing operational status of all sensors
void displaySensorPage() {
  display.clearDisplay();
  display.setTextSize(1);
  display.setTextColor(SSD1306_WHITE);
  
  // Page title
  display.setCursor(5, 0);
  display.println("-- SENSOR STATUS --");
  
  // MPU6050 Status
  display.setCursor(0, 16);
  display.print("MPU6050: ");
  if (isCalibrationComplete()) {
    display.println("Calibrated");
  } else {
    display.println("Not Calibrated");
  }
  
  // SIM800L Status
  display.setCursor(0, 28);
  display.print("SIM800L: ");
  display.println(isSimModuleReady() ? "OK" : "FAIL");
  
  // GPS Status
  display.setCursor(0, 40);
  display.print("GPS: ");
  if (isGpsValid()) {
    display.println("Fixed");
    display.setCursor(70, 40);
    display.print("Pos: ");
    display.print(getLatitude(), 2);
    display.print(",");
    display.print(getLongitude(), 2);
  } else {
    display.println("No Fix");
  }
  
  // Page number
  display.setCursor(0, 56);
  display.print("Page 2/4");
  
  display.display();
}

// Display page with QR code containing user's emergency information
void displayQrCodePage() {
  display.clearDisplay();
  
  // Page title
  display.setTextSize(1);
  display.setTextColor(SSD1306_WHITE);
  display.setCursor(10, 0);
  display.println("EMERGENCY INFO");
  
  // If we have a QR code URL, display it
  if (qrCodeUrl.length() > 0) {
    // Generate QR code
    QRCode qrcode;
    uint8_t qrcodeData[qrcode_getBufferSize(3)];
    qrcode_initText(&qrcode, qrcodeData, 3, 0, qrCodeUrl.c_str());
    
    // Calculate scaling to fit display
    int scale = 2;
    int qrSize = qrcode.size * scale;
    int offsetX = (display.width() - qrSize) / 2;
    int offsetY = ((display.height() - qrSize) / 2) + 5; // Add 5 for the title spacing
    
    // Draw QR code
    for (uint8_t y = 0; y < qrcode.size; y++) {
      for (uint8_t x = 0; x < qrcode.size; x++) {
        if (qrcode_getModule(&qrcode, x, y)) {
          display.fillRect(offsetX + x * scale, offsetY + y * scale, scale, scale, SSD1306_WHITE);
        }
      }
    }
  } else {
    // No QR code data available
    display.setCursor(10, 30);
    display.println("No emergency");
    display.setCursor(10, 40);
    display.println("data available");
  }
  
  // Page number
  display.setCursor(0, 56);
  display.print("Page 3/4");
  
  display.display();
}

// Display user instructions page
void displayInstructionsPage() {
  display.clearDisplay();
  display.setTextSize(1);
  display.setTextColor(SSD1306_WHITE);
  
  // Page title
  display.setCursor(0, 0);
  display.println("-- INSTRUCTIONS --");
  
  // SOS instructions
  display.setCursor(0, 12);
  display.println("SOS: Long press (3s) ");
  display.setCursor(0, 21);
  display.println("on touch pin 27");
  
  // BLE toggle instructions
  display.setCursor(0, 30);
  display.println("Toggle BLE: Press ");
  display.setCursor(0, 39);
  display.println("on touch pin 14");
  
  // Help message
  display.setCursor(0, 48);
  display.println("In emergency, show");
  display.println("QR code to helpers");
  
  // Page number
  display.setCursor(0, 56);
  display.print("Page 4/4");
  
  display.display();
}

// Display emergency message
void displayEmergencyMessage(const char* message) {
  display.clearDisplay();
  display.setTextSize(2);
  display.setTextColor(SSD1306_WHITE);
  
  // Center the message
  int16_t x1, y1;
  uint16_t w, h;
  display.getTextBounds(message, 0, 0, &x1, &y1, &w, &h);
  
  // Calculate position for centering if possible, otherwise just use top-left
  int xPos = (w < SCREEN_WIDTH) ? (SCREEN_WIDTH - w) / 2 : 0;
  
  display.setCursor(xPos, 20);
  display.println(message);
  display.display();
}

// Set the QR code URL
void setQRCodeUrl(const String& url) {
  qrCodeUrl = url;
}

// Set the child data for emergency QR code
void setChildData(const String& data) {
  childData = data;
  // If we have a userId, we can create a QR code URL
  if (childData.length() > 0) {
    qrCodeUrl = childData;
  }
}
